// SPDX-License-Identifier: BSD-3-Clause
/*
 * Copyright (c) Qualcomm Technologies, Inc. and/or its subsidiaries.
 */

/dts-v1/;
/plugin/;

#include "hfi_core/trustedvm-coast-hfi-core.dtsi"

/ {
	model = "Qualcomm Technologies, Inc. Coast SVM MTP";
	compatible = "qcom,coast-mtp", "qcom,coast", "qcom,mtp";
	qcom,msm-id = <761 0x10000>;
	qcom,board-id = <0x10008 0x0>, <0x20008 0x0>, <0x30008 0x0>, <0x10108 0x0>, <0x20108 0x0>, <0x30108 0x0>;
};

