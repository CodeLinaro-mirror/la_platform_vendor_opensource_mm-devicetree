// SPDX-License-Identifier: BSD-3-Clause
/*
 * Copyright (c) Qualcomm Technologies, Inc. and/or its subsidiaries.
 */

/dts-v1/;
/plugin/;

#include "hw_fence/art-hw-fence.dtsi"
#include "hfi_core/art-hfi-core.dtsi"

/ {
	model = "Qualcomm Technologies, Inc. Artl ATP";
	compatible = "qcom,artl-atp", "qcom,artl", "qcom,artlp-atp", "qcom,artlp",
			   "qcom,atp";
	qcom,msm-id = <755 0x10000>;
	qcom,board-id = <0x21 0>;
};
