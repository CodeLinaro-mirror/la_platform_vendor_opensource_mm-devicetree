// SPDX-License-Identifier: BSD-3-Clause
/*
 * Copyright (c) Qualcomm Technologies, Inc. and/or its subsidiaries.
 */

/dts-v1/;
/plugin/;

#include "hfi_core/trustedvm-art-hfi-core.dtsi"

/ {
	model = "Qualcomm Technologies, Inc. Art SVM OMTP";
	compatible = "qcom,art-omtp", "qcom,art", "qcom,artp-omtp", "qcom,artp", "qcom,omtp";
	qcom,msm-id = <707 0x10000>, <707 0x20000>, <708 0x10000>, <708 0x20000>;
	qcom,board-id = <0x10031 0>;
};
