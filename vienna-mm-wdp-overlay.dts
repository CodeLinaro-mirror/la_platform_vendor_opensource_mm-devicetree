// SPDX-License-Identifier: BSD-3-Clause
/*
 * Copyright (c) Qualcomm Technologies, Inc. and/or its subsidiaries.
 */

/dts-v1/;
/plugin/;

#include "hfi_core/vienna-hfi-core.dtsi"

/ {
	model = "Qualcomm Technologies, Inc. Vienna WDP";
	compatible = "qcom,vienna-wdp", "qcom,vienna", "qcom,wdp";
	qcom,msm-id = <669 0x10000>, <670 0x10000>;
	qcom,board-id = <36 0>, <36 1>;
};
