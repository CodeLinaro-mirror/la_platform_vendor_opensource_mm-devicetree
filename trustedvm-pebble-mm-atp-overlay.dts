// SPDX-License-Identifier: BSD-3-Clause
/*
 * Copyright (c) Qualcomm Technologies, Inc. and/or its subsidiaries.
 */

/dts-v1/;
/plugin/;


#include "hfi_core/trustedvm-pebble-hfi-core.dtsi"

/ {
	model = "Qualcomm Technologies, Inc. Pebble SVM ATP";
	compatible = "qcom,pebble-atp", "qcom,pebble", "qcom,atp";
	qcom,msm-id = <735 0x10000>, <741 0x10000>;
	qcom,board-id = <0x10021 0>, <0x20021 0x0>;
};
