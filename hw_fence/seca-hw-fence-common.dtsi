// SPDX-License-Identifier: BSD-3-Clause
/*
 * Copyright (c) Qualcomm Technologies, Inc. and/or its subsidiaries.
 */

&soc {
	msm_hw_fence: qcom,hw-fence {
		compatible = "qcom,msm-hw-fence";
		status = "ok";

		qcom,hw-fence-table-entries = <8192>;
		qcom,hw-fence-queue-entries = <800>;
		qcom,ipcc-reg = <0x9000000 0x400000>;
		qcom,soccp-ver = <1>;

		/* time register */
		qcom,qtime-reg = <0xC221000 0x1000>;

		/* ipc version*/
		qcom,hw-fence-ipc-ver = <0x30001>;

		qcom,hw-fence-client-type-gpu = <2 2 800 0>;
		qcom,hw-fence-client-type-gpu1 = <2 2 800 0>;
		qcom,hw-fence-client-type-dpu = <8 1 128 1>;
		qcom,hw-fence-client-type-dpu1 = <8 1 128 1>;
		qcom,hw-fence-client-type-val = <4 2 0 0>;
		qcom,hw-fence-client-type-test1 = <4 2 64 0>;
		qcom,hw-fence-client-type-test2 = <4 2 64 0>;
		qcom,hw-fence-client-type-test3 = <4 2 64 0>;
		qcom,hw-fence-client-type-test4 = <4 2 64 0>;
		qcom,hw-fence-client-type-vpu = <2 2 128 0>;
		qcom,hw-fence-client-type-nsp0 = <2 2 128 0>;
		qcom,hw-fence-client-type-nsp1 = <2 2 128 0>;
		qcom,hw-fence-client-type-nsp2 = <2 2 128 0>;
		qcom,hw-fence-client-type-nsp3 = <2 2 128 0>;

	};
};
