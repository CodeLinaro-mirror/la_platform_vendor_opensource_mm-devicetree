// SPDX-License-Identifier: BSD-3-Clause
/*
 * Copyright (c) Qualcomm Technologies, Inc. and/or its subsidiaries.
 */

/dts-v1/;
/plugin/;

#include "pikachu-hw-fence.dtsi"

/ {
	model = "Qualcomm Technologies, Inc. pikachu SoC";
	qcom,msm-id = <736 0x10000>, <737 0x10000>;
	qcom,board-id = <0 0>,<15 0>;
};
