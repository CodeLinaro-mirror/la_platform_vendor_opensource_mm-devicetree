// SPDX-License-Identifier: BSD-3-Clause
/*
 * Copyright (c) Qualcomm Technologies, Inc. and/or its subsidiaries.
 */

#include <dt-bindings/interrupt-controller/arm-gic.h>

&soc {
	msm_hw_fence: qcom,hw-fence {
		compatible = "qcom,msm-hw-fence";
		status = "ok";

		/* SOCCP properties */
		interrupts = <GIC_ESPI 134 IRQ_TYPE_LEVEL_HIGH>;
		interrupt-controller;
		#interrupt-cells = <1>;
		iommus = <&apps_smmu 0x162 0x1>;
		dma-coherent;
		soccp_controller = <&soccp_pas>;
		shbuf_soccp_va = <0xd0000000>;

		qcom,hw-fence-page-size = <16384>;
		qcom,hw-fence-table-entries = <8192>;
		qcom,hw-fence-queue-entries = <800>;
		qcom,ipcc-reg = <0x1100000 0x400000>;

		/* time register */
		qcom,qtime-reg = <0xC221000 0x1000>;

		/* ipc version */
		qcom,hw-fence-ipc-ver = <0x30204>;

		/* base client queue properties */
		qcom,hw-fence-client-type-dpu = <0 1 128 1>;
		qcom,hw-fence-client-type-val = <7 2 128 0>;
		qcom,hw-fence-client-type-vpu = <1 2 400 0>;
		qcom,hw-fence-client-type-dcp = <1 2 400 0>;
		qcom,hw-fence-client-type-nsp0 = <1 2 400 0>;
		qcom,hw-fence-client-type-ife0 = <5 1 128 1>;
		qcom,hw-fence-client-type-ife1 = <5 1 128 1>;
		qcom,hw-fence-client-type-ife2 = <5 1 128 1>;

	};
};
