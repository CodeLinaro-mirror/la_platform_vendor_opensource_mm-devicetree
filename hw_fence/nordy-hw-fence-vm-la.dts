// SPDX-License-Identifier: BSD-3-Clause
/*
 * Copyright (c) Qualcomm Technologies, Inc. and/or its subsidiaries.
 */

/dts-v1/;
/plugin/;

#include "nordy-hw-fence-vm-la.dtsi"

/ {
	model = "Qualcomm Technologies, Inc. SA8797 Single LA Guest Virtual Machine";
	compatible = "qcom,nordy", "qcom,qam";
	qcom,msm-id = <690 0x10000>, <690 0x20000>, <690 0x10001>;
	qcom,board-id = <0x10025 0x0>;
};
