// SPDX-License-Identifier: BSD-3-Clause
/*
 * Copyright (c) Qualcomm Technologies, Inc. and/or its subsidiaries.
 */

#include <dt-bindings/interrupt-controller/arm-gic.h>
//#include <dt-bindings/mailbox/qcom-ipcc-seraph.h>
#include <dt-bindings/mailbox/qcom-ipcc.h>

&soc {
	hfi_core_iommu_region_partition: hfi_core_iommu_region_partition {
		iommu-addresses = <&msm_hfi_core 0x0 0x88000000>,
				<&msm_hfi_core 0x90000000 0x70000000>;
	};

	msm_hfi_core: qcom,hfi-core {
		compatible = "qcom,msm-hfi-core";
		status = "ok";

		depends-on-supply = <&qcom_smp2p_dcp>;

		/* MBOX properties */
		mboxes = <&ipcc_mproc IPCC_CLIENT_DCP 5>,
				<&ipcc_mproc IPCC_CLIENT_DCP 6>,
				<&ipcc_mproc IPCC_CLIENT_APSS 5>,
				<&ipcc_mproc IPCC_CLIENT_APSS 6>;
		interrupts-extended = <&ipcc_mproc IPCC_CLIENT_DCP 5 IRQ_TYPE_EDGE_RISING>,
				<&ipcc_mproc IPCC_CLIENT_DCP 6 IRQ_TYPE_EDGE_RISING>,
				<&ipcc_mproc IPCC_CLIENT_APSS 5 IRQ_TYPE_EDGE_RISING>,
				<&ipcc_mproc IPCC_CLIENT_APSS 6 IRQ_TYPE_EDGE_RISING>,
				<&intc GIC_SPI 347 IRQ_TYPE_EDGE_RISING>,
				<&dcp_smp2p_in 0 IRQ_TYPE_NONE>,
				<&dcp_smp2p_in 1 IRQ_TYPE_NONE>,
				<&dcp_smp2p_in 2 IRQ_TYPE_NONE>,
				<&dcp_smp2p_in 9 IRQ_TYPE_NONE>,
				<&dcp_smp2p_in 3 IRQ_TYPE_NONE>;

		interrupt-names = "dcp_power_notify_irq",
					"dcp_event_notify_irq",
					"apss_power_notify_irq",
					"apss_event_notify_irq",
					"dcp_wdog_bus_error_irq",
					"smp2p_fatal_irq",
					"smp2p_err_service_ready_irq",
					"smp2p_dcp_clock_ready_irq",
					"smp2p_dcp_pong_irq",
					"smp2p_dcp_stop_ack_irq";

		/* smp2p communication from apss to dcp */
		qcom,smem-states = <&dcp_smp2p_out 0>, <&dcp_smp2p_out 8>, <&dcp_smp2p_out 11>,
				   <&dcp_smp2p_out 12>;
		qcom,smem-state-names = "stop", "ping", "wdog", "fatal";

		/* DCP properties */
		iommus = <&apps_smmu 0x19A3 0x0>;
		qcom,iommu-group = <&dcp_cb_group>;
		dma-coherent;
		memory-region = <&hfi_core_iommu_region_partition>;

		/* page 0, page 1, rscc_rsc, rvsscp_status, dcp_proc_h_cbcr */
		reg = <0x9ab0000 0x1000>,
		      <0x9ab1000 0x1000>,
		      <0x9920408 0x4>,
		      <0x9a70000 0x4>,
		      <0x9912030 0x4>,
			  <0x9930000 0x70>;
		reg-names = "swi_page0", "swi_dev0", "sde_rscc_rsc",
			    "dcp_rvcp_rvsscp_status", "disp_cc_dcp_proc_h_cbcr",
				"sde_rscc_wrapper";

		/* firmware map start addr and max size */
		qcom,device-map-addr-reg = <0x88000000 0x8000000>;

		/* firmware image specific information */
		qcom,pas-id = <63>;
		fw-memory-region = <&dcp_mem>;
		qcom,fw_image_name = "dcp.mbn";

		/* dcp fast reset on low power collapse */
		qcom,enable-dcp-fast-reset;

		/* Enable DCP SSR */
		qcom,enable-ssr;
	};
};
