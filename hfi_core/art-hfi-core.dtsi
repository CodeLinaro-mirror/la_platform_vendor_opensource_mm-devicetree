// SPDX-License-Identifier: BSD-3-Clause
/*
 * Copyright (c) Qualcomm Technologies, Inc. and/or its subsidiaries.
 */

#include <dt-bindings/interrupt-controller/arm-gic.h>
#include <dt-bindings/mailbox/qcom-ipcc-art.h>
#include <dt-bindings/mailbox/qcom-ipcc.h>

&soc {
	msm_hfi_core: qcom,hfi-core {
		compatible = "qcom,msm-hfi-core";
		status = "ok";

		depends-on-supply = <&qcom_smp2p_dcp>;

		/* MBOX properties */
		mboxes = <&ipcc_mproc IPCC_MPROC_DCP 5>,
				<&ipcc_mproc IPCC_MPROC_DCP 6>,
				<&ipcc_mproc IPCC_MPROC_APSS 5>,
				<&ipcc_mproc IPCC_MPROC_APSS 6>;
		interrupts-extended = <&ipcc_mproc IPCC_MPROC_DCP 5 IRQ_TYPE_EDGE_RISING>,
				<&ipcc_mproc IPCC_MPROC_DCP 6 IRQ_TYPE_EDGE_RISING>,
				<&ipcc_mproc IPCC_MPROC_APSS 5 IRQ_TYPE_EDGE_RISING>,
				<&ipcc_mproc IPCC_MPROC_APSS 6 IRQ_TYPE_EDGE_RISING>;

		interrupt-names = "dcp_power_notify_irq",
					"dcp_event_notify_irq",
					"apss_power_notify_irq",
					"apss_event_notify_irq";

		/* DCP properties */
		iommus = <&apps_smmu 0x15A3 0x0>;
		dma-coherent;

		/* Page 1 */
		reg = <0x0 0x9c61000 0x0 0x1000>;
		reg-names = "swi_dev0";

		/* firmware map start addr and max size */
		qcom,device-map-addr-reg = <0x84000000 0x4000000>;
	};
};
