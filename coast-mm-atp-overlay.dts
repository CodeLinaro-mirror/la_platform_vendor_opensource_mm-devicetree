// SPDX-License-Identifier: BSD-3-Clause
/*
 * Copyright (c) Qualcomm Technologies, Inc. and/or its subsidiaries.
 */

/dts-v1/;
/plugin/;

#include "hfi_core/coast-hfi-core.dtsi"

/ {
	model = "Qualcomm Technologies, Inc. Coast ATP";
	compatible = "qcom,coast-atp", "qcom,atp", "qcom,coast";
	qcom,msm-id = <761 0x10000>;
	qcom,board-id = <0x10021 0x0>;
};
