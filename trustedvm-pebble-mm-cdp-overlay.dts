// SPDX-License-Identifier: BSD-3-Clause
/*
 * Copyright (c) Qualcomm Technologies, Inc. and/or its subsidiaries.
 */

/dts-v1/;
/plugin/;

#include "hfi_core/trustedvm-pebble-hfi-core.dtsi"

/ {
	model = "Qualcomm Technologies, Inc. Pebble SVM CDP";
	compatible = "qcom,pebble-cdp", "qcom,pebble", "qcom,cdp";
	qcom,msm-id = <735 0x10000>, <741 0x10000>;
	qcom,board-id = <0x10001 0>;
};
