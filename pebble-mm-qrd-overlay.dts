// SPDX-License-Identifier: BSD-3-Clause
/*
 * Copyright (c) Qualcomm Technologies, Inc. and/or its subsidiaries.
 */

/dts-v1/;
/plugin/;

#include "hw_fence/pebble-hw-fence.dtsi"
#include "hfi_core/pebble-hfi-core.dtsi"

/ {
	model = "Qualcomm Technologies, Inc. Pebble QRD";
	compatible = "qcom,pebble-qrd", "qcom,qrd", "qcom,pebble";
	qcom,msm-id = <735 0x10000>, <741 0x10000>;
	qcom,board-id = <0x1000b 0x0>, <0x2000b 0x0>, <0x1010b 0x0>;
};

